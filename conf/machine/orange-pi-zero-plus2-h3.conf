## conf/machine/orange-pi-zero-plus2-h3.conf
```bitbake
#@TYPE: Machine
#@NAME: orange-pi-zero-plus2-h3
#@DESCRIPTION: Machine configuration for the orange-pi-zero-plus2, based on allwinner H3 CPU

require conf/machine/include/sun8i.inc

PREFERRED_VERSION_u-boot = "v2018.03%"

KERNEL_DEVICETREE = "sun8i-h3-orangepi-zeroplus2.dtb"
UBOOT_MACHINE = "orangepi_zero_plus2_h3_defconfig"
```
